## config/boards/shields/Arum/Kconfig.shield
```kconfig
config SHIELD_ARUM_LEFT
    def_bool $(shields_list_contains,arum_left)

config SHIELD_ARUM_RIGHT
    def_bool $(shields_list_contains,arum_right)
```

## config/boards/shields/arum/Kconfig.defconfig
```kconfig
if SHIELD_ARUM_LEFT
config ZMK_KEYBOARD_NAME
    default "Arum"

config ZMK_SPLIT_ROLE_CENTRAL
    default y
endif

if SHIELD_ARUM_LEFT || SHIELD_ARUM_RIGHT
config ZMK_SPLIT_ROLE_CENTRAL
    default y

config ZMK_SPLIT
	default y
    
config SPI
    default y

endif
```
